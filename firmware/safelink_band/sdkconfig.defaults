## firmware/safelink_band/sdkconfig.defaults
```kconfig
# NimBLE Configuration for ESP32-C6
CONFIG_BT_ENABLED=y
CONFIG_BT_NIMBLE_ENABLED=y
CONFIG_BT_NIMBLE_ROLE_PERIPHERAL=y
CONFIG_BT_NIMBLE_ROLE_CENTRAL=y
CONFIG_BT_NIMBLE_ROLE_BROADCASTER=n
CONFIG_BT_NIMBLE_ROLE_OBSERVER=y

# GATT Server Configuration
CONFIG_BT_NIMBLE_SVC_GAP_DEVICE_NAME="ESP32C6_Band"
CONFIG_BT_NIMBLE_GAP_DEVICE_NAME_MAX_LEN=31

# Scanning Configuration
CONFIG_BT_NIMBLE_BLE_GATT_BLOB_TRANSFER=y

# Security Configuration
CONFIG_BT_NIMBLE_SM_SC_DEBUG_KEYS=y
CONFIG_BT_NIMBLE_SM_LVL=0

# Memory Configuration
CONFIG_BT_NIMBLE_MEM_ALLOC_MODE_EXTERNAL=y
CONFIG_BT_NIMBLE_MEM_ALLOC_MODE_INTERNAL=n

# Logging Configuration
CONFIG_BT_NIMBLE_LOG_LEVEL_INFO=y
CONFIG_BT_NIMBLE_LOG_LEVEL_DEBUG=n

# Disable Classic Bluetooth
CONFIG_BT_CLASSIC_ENABLED=n
CONFIG_BT_BLUEDROID_ENABLED=n

# Logging
CONFIG_LOG_DEFAULT_LEVEL_INFO=y
CONFIG_LOG_MAXIMUM_LEVEL_VERBOSE=y

# FreeRTOS
CONFIG_FREERTOS_HZ=1000

# GPIO
CONFIG_GPIO_ESP32_SUPPORT_SWITCH_SLP_PULL=y

# I2C
CONFIG_I2C_ENABLE_DEBUG_LOG=y

# ADC
CONFIG_ADC_ENABLE_DEBUG_LOG=y

# NVS Flash
CONFIG_NVS_ENCRYPTION=n 
```

## firmware/safelink_hub/sdkconfig.defaults
```kconfig
# SafeLink Vest Hub ESP32-C6 Configuration

# Target Configuration
CONFIG_IDF_TARGET="esp32c6"

# Bluetooth Configuration
CONFIG_BT_ENABLED=y
CONFIG_BT_BLE_ENABLED=y
CONFIG_BT_NIMBLE_ENABLED=y
CONFIG_BT_NIMBLE_MAX_CONNECTIONS=4
CONFIG_BT_NIMBLE_ROLE_CENTRAL=y
CONFIG_BT_NIMBLE_ROLE_PERIPHERAL=y
CONFIG_BT_NIMBLE_ROLE_BROADCASTER=y
CONFIG_BT_NIMBLE_ROLE_OBSERVER=y

# WiFi Configuration
CONFIG_WIFI_ENABLED=y

# Audio Configuration
CONFIG_ESP32C6_I2S_ENABLED=y

# Power Management
CONFIG_PM_ENABLE=y
CONFIG_FREERTOS_USE_TICKLESS_IDLE=y

# FreeRTOS Configuration
CONFIG_FREERTOS_HZ=1000

# Log Configuration
CONFIG_LOG_DEFAULT_LEVEL_INFO=y

# Partition Configuration
CONFIG_PARTITION_TABLE_CUSTOM=y
CONFIG_PARTITION_TABLE_CUSTOM_FILENAME="partitions.csv"

# Memory Configuration
CONFIG_MAIN_TASK_STACK_SIZE=8192 
```

## firmware/safelink_wearable/sdkconfig.defaults
```kconfig
# SafeLink Wearable ESP32-C6 Configuration

# Target Configuration
CONFIG_IDF_TARGET="esp32c6"

# Bluetooth Configuration
CONFIG_BT_ENABLED=y
CONFIG_BT_BLE_ENABLED=y
CONFIG_BT_NIMBLE_ENABLED=y

# WiFi Configuration
CONFIG_WIFI_ENABLED=y

# Power Management
CONFIG_PM_ENABLE=y
CONFIG_FREERTOS_USE_TICKLESS_IDLE=y

# FreeRTOS Configuration
CONFIG_FREERTOS_HZ=1000

# Log Configuration
CONFIG_LOG_DEFAULT_LEVEL_INFO=y

# Partition Configuration
CONFIG_PARTITION_TABLE_CUSTOM=y
CONFIG_PARTITION_TABLE_CUSTOM_FILENAME="partitions.csv" 
```

## test_bluetooth_sensor/sdkconfig.defaults
```kconfig
# ESP32-C6 Target Configuration
CONFIG_IDF_TARGET="esp32c6"

# NimBLE Configuration
CONFIG_BT_ENABLED=y
CONFIG_BT_NIMBLE_ENABLED=y
CONFIG_BT_CONTROLLER_ENABLED=n
CONFIG_BT_NIMBLE_ROLE_PERIPHERAL=y
CONFIG_BT_NIMBLE_ROLE_CENTRAL=n
CONFIG_BT_NIMBLE_ROLE_BROADCASTER=n
CONFIG_BT_NIMBLE_ROLE_OBSERVER=n

# NimBLE Memory Configuration
CONFIG_BT_NIMBLE_MEM_ALLOC_MODE_EXTERNAL=y
CONFIG_BT_NIMBLE_LOG_LEVEL_INFO=y

# NimBLE GATT Configuration
CONFIG_BT_NIMBLE_SVC_GAP_DEVICE_NAME="ESP32C6_Sensor"
CONFIG_BT_NIMBLE_GAP_DEVICE_NAME_MAX_LEN=31

# NimBLE Security Configuration
CONFIG_BT_NIMBLE_SM_SC_DEBUG_KEYS=y

# NimBLE Host Configuration
CONFIG_BT_NIMBLE_MAX_CONNECTIONS=1
CONFIG_BT_NIMBLE_MAX_BONDS=3
CONFIG_BT_NIMBLE_MAX_CCCDS=8

# FreeRTOS Configuration
CONFIG_FREERTOS_HZ=1000
CONFIG_FREERTOS_USE_TRACE_FACILITY=y
CONFIG_FREERTOS_USE_STATS_FORMATTING_FUNCTIONS=y

# Logging Configuration
CONFIG_LOG_DEFAULT_LEVEL_INFO=y
CONFIG_LOG_MAXIMUM_LEVEL_VERBOSE=y

# NVS Configuration
CONFIG_NVS_ENCRYPTION=n

# ADC Configuration
CONFIG_ADC_DISABLE_DAC=y

# I2C Configuration
CONFIG_I2C_MASTER_TIMEOUT_MS=1000 
```

## test_gpio_blink/sdkconfig.defaults
```kconfig
# ESP32-C6 GPIO Blink Test Configuration

# Target Configuration
CONFIG_IDF_TARGET="esp32c6"

# GPIO Configuration
CONFIG_GPIO_ESP32C6_SUPPORT_SWITCH_SLP_PULL=y

# FreeRTOS Configuration
CONFIG_FREERTOS_HZ=1000

# Log Configuration
CONFIG_LOG_DEFAULT_LEVEL_INFO=y
CONFIG_LOG_MAXIMUM_LEVEL_VERBOSE=y

# Main task stack size
CONFIG_MAIN_TASK_STACK_SIZE=4096

# Serial flasher config
CONFIG_ESPTOOLPY_FLASHSIZE_4MB=y 
```

## test_sensor_am2320_heartbeat/sdkconfig.defaults
```kconfig
# ESP-PICO Sensor Test Configuration (AM2320 + Heartbeat)

# Target Configuration
CONFIG_IDF_TARGET="esp32c6"

# I2C Configuration for AM2320
CONFIG_I2C_ENABLE_DEBUG_LOG=y
CONFIG_I2C_MASTER_TIMEOUT_MS=1000

# ADC Configuration for Heartbeat Sensor
CONFIG_ADC_DISABLE_DAC=y
CONFIG_ADC_CAL_EFUSE_TP_ENABLE=y
CONFIG_ADC_CAL_EFUSE_VREF_ENABLE=y
CONFIG_ADC_CAL_LUT_ENABLE=y

# FreeRTOS Configuration
CONFIG_FREERTOS_HZ=1000

# Log Configuration
CONFIG_LOG_DEFAULT_LEVEL_INFO=y
CONFIG_LOG_MAXIMUM_LEVEL_VERBOSE=y

# Main task stack size
CONFIG_MAIN_TASK_STACK_SIZE=8192

# Serial flasher config
CONFIG_ESPTOOLPY_FLASHSIZE_4MB=y

# UART Configuration
CONFIG_ESP_CONSOLE_UART_NUM=0
CONFIG_ESP_CONSOLE_UART_BAUDRATE=115200

# Bluetooth Configuration
CONFIG_BT_ENABLED=y
CONFIG_BT_BLUEDROID_ENABLED=y
CONFIG_BT_BLE_ENABLED=n
CONFIG_BT_CLASSIC_ENABLED=y
CONFIG_BT_CONTROLLER_ENABLED=y
CONFIG_BT_CONTROLLER_ONLY=n
CONFIG_BT_SPP_ENABLED=y
CONFIG_BT_NIMBLE_ENABLED=n 
```
